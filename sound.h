#ifndef _sound_h
#define _sound_h

#include <Arduino.h>
#include "constants.h"

extern bool sound_enabled;

// Les données sonores restent les mêmes
constexpr uint8_t GET_KEY_SND_LEN = 90;
constexpr uint8_t SHOOT_SND_LEN = 27;
constexpr uint8_t shoot_snd[] PROGMEM = { 0x10, 0x10 , 0x10 , 0x6e , 0x2a , 0x20 , 0x28 , 0x28 , 0x9b , 0x28 , 0x20 , 0x20 , 0x21 , 0x57 , 0x20 , 0x20 , 0x20 , 0x67 , 0x20 , 0x20 , 0x29 , 0x20 , 0x73 , 0x20 , 0x20 , 0x20 , 0x89};
constexpr uint8_t get_key_snd[] PROGMEM = {0x24, 0x24, 0x24 , 0x24 , 0x24 , 0x24 , 0x24 , 0x24 , 0x24 , 0x24 , 0x24 , 0x24 , 0x24 ,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 0x19 , 0x19 };
constexpr uint8_t HIT_WALL_SND_LEN = 8;
constexpr uint8_t hit_wall_snd[] PROGMEM = { 0x83 , 0x83 , 0x82 , 0x8e , 0x8a , 0x89 , 0x86 , 0x84};
constexpr uint8_t WALK1_SND_LEN = 3;
constexpr uint8_t walk1_snd[] PROGMEM = { 0x8f, 0x8e, 0x8e};
constexpr uint8_t WALK2_SND_LEN = 3;
constexpr uint8_t walk2_snd[] PROGMEM = { 0x84, 0x87, 0x84};
constexpr uint8_t MEDKIT_SND_LEN = 69;
constexpr uint8_t medkit_snd[] PROGMEM = {0x55 , 0x20 , 0x3a , 0x3a , 0x3a , 0x20 , 0x20 , 0x20 , 0x20 , 0x20 , 0x20 , 0x20 , 0x33 ,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 0x15, 0x15};


// Variables d'état pour le son
bool sound_is_playing = false;
const uint8_t* current_sound_ptr = nullptr;
uint8_t current_sound_len = 0;
uint8_t sound_idx = 0;
unsigned long last_sound_update = 0;
// Le son original est à 140Hz, soit un changement toutes les ~7ms
const int SOUND_UPDATE_INTERVAL = 7; 

void sound_init() {
  // La fonction tone() de l'ESP32 configure la broche automatiquement.
}

void off() {
  noTone(SOUND_PIN);
  sound_is_playing = false;
}

void playSound(const uint8_t* snd, uint8_t len) {
  if (!sound_enabled || sound_is_playing) return; // Ne pas interrompre un son en cours
  
  current_sound_ptr = snd;
  current_sound_len = len;
  sound_idx = 0;
  sound_is_playing = true;
  last_sound_update = millis();
}

void updateSound() {
  if (sound_is_playing) {
    if (millis() - last_sound_update > SOUND_UPDATE_INTERVAL) {
      if (sound_idx < current_sound_len) {
        // Lire la valeur depuis la PROGMEM
        uint8_t freq_data = pgm_read_byte(current_sound_ptr + sound_idx);
        
        // Calculer la fréquence
        // 1192030 est la constante de l'horloge sonore du jeu original (PC Speaker)
        // On la garde pour que les sons aient la même tonalité
        uint16_t freq = 1192030 / (60 * (uint16_t) freq_data);
        
        tone(SOUND_PIN, freq);
        
        sound_idx++;
        last_sound_update = millis();
      } else {
        off();
      }
    }
  }
}

#endif